## tuyaopen-overlay/boards/T5AI/Kconfig.patch
```kconfig
diff --git a/boards/T5AI/Kconfig b/boards/T5AI/Kconfig
index 1ed7e59..63eef1c 100644
--- a/boards/T5AI/Kconfig
+++ b/boards/T5AI/Kconfig
@@ -146,6 +146,12 @@ choice
             rsource "./NICEMCU_T5_0_96ISP/Kconfig"
         endif
 
+    config BOARD_CHOICE_LINKH_T5E1
+        bool "LINKH_T5E1"
+        if (BOARD_CHOICE_LINKH_T5E1)
+            rsource "./LINKH_T5E1/Kconfig"
+        endif
+
 # <new-board-add: This line cannot be deleted or modified>
 
 endchoice
```

## tuyaopen-overlay/boards/T5AI/LINKH_T5E1/Kconfig
```kconfig
config CHIP_CHOICE
    string
    default "T5AI"

config BOARD_CHOICE
    string
    default "LINKH_T5E1"

config BOARD_CONFIG
    bool
    default y
    select ENABLE_AUDIO_CODECS
    select ENABLE_AUDIO_AEC
```

## xiuos-overlay/board/bk7258/Kconfig
```kconfig
mainmenu "XiUOS Project Configuration"

config BSP_DIR
    string
    option env="BSP_ROOT"
    default "."

config KERNEL_DIR
    string
    option env="KERNEL_ROOT"
    default "../.."

config BOARD_BK7258
    bool
    select ARCH_ARM
    default y

source "$KERNEL_DIR/arch/Kconfig"

menu "bk7258 feature"
    source "$BSP_DIR/third_party_driver/Kconfig"

    menu "config default board resources"
        menu "config board app name"
            config BOARD_APP_NAME
                string "config board app name"
                default "/XiUOS_bk7258_app.bin"
        endmenu

        menu "config board service table"
            config SERVICE_TABLE_ADDRESS
                hex "board service table address"
                # BK7258 AP 核 RAM 起点（实测 0x28010000），
                # 与 nuvoton 写 0x20000000 是同一个意思：SRAM 基址。
                default 0x28010000
        endmenu

    endmenu

endmenu

menu "Hardware feature"
    source "$KERNEL_DIR/resources/Kconfig"
endmenu

source "$KERNEL_DIR/Kconfig"
```
